## ITE_Castor3_SDK/project/test_fs/Kconfig
```kconfig
#
# For a description of the syntax of this configuration file,
# see Documentation/kbuild/kconfig-language.txt.
#

mainmenu "Project Configuration"

config TEST_FS
    bool
    default y
    select HAVE_LCD
    select HAVE_GRAPHICS
    select HAVE_AUDIO
    select HAVE_VIDEO

config DEF_CHIP_PKG_IT9856
    def_bool y

config DEF_CHIP_REV_A0
    def_bool y  

config RAM_SIZE
    default "0x4000000"

config RAM_INIT_SCRIPT
    default "IT9850A0_360MHz.scr"

config DBG_INIT_SCRIPT
	default "IT9850A0_400MHz.txt"

config CMAKE_SOURCE_DIR
	string
	option env="CMAKE_SOURCE_DIR"

config UART1_ENABLE
    def_bool y

config GPIO_UART1_TX
    default "4"

config GPIO_UART1_RX
    default "-1"

config SD0_ENABLE
	def_bool y

config SD0_STATIC
	def_bool y

config FS_FAT
	def_bool y

source "$CMAKE_SOURCE_DIR/sdk/Kconfig"

menu "File System Test"

choice
	prompt "Test App"
	default TEST_FILESYSTEM

config TEST_FAT
	bool "FAT"

config TEST_DRIVE
	bool "Drive"

config TEST_FILESYSTEM
	bool "FileSystem"

config TEST_NTFS
	bool "NTFS"

endchoice

endmenu
```

## ITE_Castor3_SDK/project/test_fs/Kconfig.win32
```kconfig
#
# For a description of the syntax of this configuration file,
# see Documentation/kbuild/kconfig-language.txt.
#

mainmenu "Project Configuration"

config TEST_FS
    bool
    default y
    select HAVE_LCD
    select HAVE_GRAPHICS
    select HAVE_AUDIO
    select HAVE_VIDEO

config CMAKE_SOURCE_DIR
	string
	option env="CMAKE_SOURCE_DIR"

config SD0_ENABLE
	def_bool y

config SD0_STATIC
	def_bool y

config FS_FAT
	def_bool y

source "$CMAKE_SOURCE_DIR/sdk/Kconfig"

menu "File System Test"

choice
	prompt "Test App"
	default TEST_FILESYSTEM

config TEST_FAT
	bool "FAT"

config TEST_DRIVE
	bool "Drive"

config TEST_FILESYSTEM
	bool "FileSystem"

config TEST_NTFS
	bool "NTFS"

endchoice

endmenu
```
